/*@!Encoding:936*/
includes
{
//#if TOOL_MAJOR_VERSION >= 13
//  #pragma library ("..\Modules\capldll.vmodule")
//#else
//  #if X64
//    #pragma library("..\Modules\Windows-x64\capldll.dll")
//  #else
//    #pragma library("..\Modules\Windows-x86\capldll.dll")
//  #endif
//#endif
  
  #pragma library ("..\..\build\capldll.dll")
}

variables 
{
//  byte gBufferGet[10];
//  byte gBufferPut[10] = { 9, 8, 7, 55, 66, 77, 0, 0, 0, 0};

  DWORD gHandle;
}

MainTest()
{
  TC_ENT();
}

testcase TC_ENT()
{
  char testText_FileName[512];
  char testText[0xFFFF] = "26065169690180663966683270243213615859510233740475174149156657656428236120051623189484972671725662583563157746405487084579028285207238480345506004339663748485357496053682054335843116788528600942302803635112234657647492639557758830962842006387220657531325401209890295498889943389377170218788922559503335020859663741552192229347242253237163267594756422485690523682627168079742944174750902823570467575965464807365131612619551481964051654925457795768272372906213086043153026564598463743490530957681548468658068475703345869428890614783807216519396341962215048628878637341745712996876849160772958358612988842460738586835021900739824082699360263697497759986323227273714515492305034688706191427627156283622979387766290270261821743597589396697574918197335255188674531035368818839229324440496022216804466181542019529599032602429009071917506297159882629885318841706649774542873477605934176702179626165442055412513030793550287860314931078365661632572529699416931468522695593668912209242175716178509226401555809245920352574451542946202482252241973699379848697124559757578511533686938731509801197537540518734964571694923614447211731284384751629506341069874281284652145423875478037120109264446104899814009387151167910944251905717094888218396783795304112787531096218059717343496683271524115379938611047148268619309670393952935340694378347921320879853387977298833016650753658601343646547847386941872363628226354163821517421587831619925397146408587103678122783509735330592093489403091371129798590673109690976019288225511324703212096294433942255654556321116735933674292330715449923207918091580286488020734492045974397502467471841778764013686085906116162560474224389337235717279488775487446678012868498024465121325756386572121300285459772096743878321814471915705594118241769930277954025888806334687785422862224284503989337962822143841399879826234165666794414905626094315738743781649393342187220918280753652983698721413727842593299893303523500562551524154268675790509310156412264560935004631479667515221675150617454512427252752194163208687089813517760507396723305345770116136111611388972533316402379592178866292516110817193505111441657972617819422895670675512829929386072308299843216918087866385128354480485944541793096110638881482575529148844234974343452751078133305599502697575910007289397283237021096650248547196248784568905481025105525405985030782700151153473188474234533309865771039760799349040338696703710931046336638666371204643027251152873623027553130097181464778339263693013153911799148544901371249545156135615194775764486679020593501740108348295265463329067928639518345840594131520643484761798206402803273511553330425152705274310360785336514942834043829957316531675626384489362276742510187261046578496587733344448764188585338290040166729173500045982571748755866024244426493184121673115949745861695272888276428094975321066434834323556467104233042939436878060013480566998517167517545270814772934944770247450416519938819647648538301168139331471725359345125509310526707722245442699645377839186572841005217231541545420129031594039246692553558801870410253807914294743615436114098194761733575657163739441644350156553280114081516309886610567674645972692905074023404237568174907871501935127648362505010995061543136327379359804046038650621727871936720870845586067971270590958503778845991548200466761708241039509165959509748416062907078382155882433733480059107710162241143511802363277418382766326848418393576823063098073909650447141808531929526581195488606360094169652406146810555690311237011335205554935459647977014216980233130357843024625740556288958104395330813777823658057980061677404618358605008306334541518428734508979060435662323724291233056876946728651299772954614742121266400755426389323424507340247273395510335120574838136313862865473160856839753792611828994809264585760107286204770178926878082389277167369784670470481162166099668831070257539479620968478162785747498682680941191712621645039681759264882293301186181988701335224462496967658821441849556751669707575914851648783332872419555185759036295324342642238087509578256622838442356763079869420703528444662185367153148283391848630222331889046724272251479834690779261676039434146087215995346347569397512247892534235543386624768363378104214487267401193314336426972250050741298813832271451935774741431771831172956479113648662781738171318275669597394511635381044276292798938329372181247206534521383611284562278910208353249096556632638991348669513766781316026314179555178728953848515863792921403770086297200665405634943178204318293277466314022612584843197285910014872625396249952735623384897833628889462292840294363852983229513182272697136770290726712957955908051088206690060313666820946076312373721583366733442935649124372341842264862236405860798129292126505797674746112894768439837736575153530268277454723511915256519126431231374148225597979681557340158656494697421527315076596494547316789355767908070522039925294253957545496480614647510484519183992866637098507443946498822856596918895528782545651761082652948877723084776122395107681977347281430218332630786985685926115277386126997357151969216859907871469536767369942097717716154989921061267734004688497270439808216674983477124528554428521069674374220754737451913840608639433499984034273618024697260481707799310757642977848557194145661211274555562546075289308321570975869422478332168573044797844353451164451746173828336126121525067816935738682441378889920889155338231681640779278919599241479384927519425566854575317244306523760316732405691411255515619541205528737448927117482271626399108035548431972045530680227328935284903280172651325881435012342811409497410114791354781924859796271465526372120137806727328396491360232119892165595369119211194461952712116236758002608854619934214711633649491885464464348361343071971844962654795698245319971173950985215372253188243781292680409087189404872944024494026812329221536944266373992546168993385922860151711520470989792776652398691649732334929011311900572776127000967673776576977236008918628178835299214659789609459739927946842135776579522842811691666344006233731132762834194949998092422545120140351117689512515807854652284527689054560892425186951188604473156760841212033163563340529164235817913425828082348698779749121393110316756060122679333399293583349676256403056522776062162755833596930363503121834540946035210649924842019614213324641085966569657905770775742016308973556633306017485228272068979490248067456964075570536222077340786274475759502961991989608352655008095916408758669034445148096908686758189751375236615593789902709167482751638963855193318959297953215764747808703021756383351995898955854546765688065173943663242074969202840446537864732823873539053875108861370425642583785222469976494494752175650666572863875694786066463349576519716278894950802334957517334367940499460820966665293872776277983945489076959643742159167106575182701089072159713355549367131545344180336610641935502906920335423372478204241343961196535916322359286729797773424095687267849359671514808704937";
  char sampBit[4]  = "bit";
  char sampByte[5] = "byte";
  char samp[5];
  byte binary;
  dword textLength;
  double ent, chisq, mean, montepi, scc, chip, errorPct;
  long   compRate;
  
//  getAbsFilePath("randomValue.ini", testText_FileName, elCount(testText_FileName));
//  setFilePath(testText_FileName , 2);
//  setWritePath("EXAMPLE");
//  getProfileString("Test", "text", "Null", testText, elcount(testText), "randomValue.ini");
  
  binary = 0;
  if(binary)
  {
    strncpy(samp, sampBit, 5);
  }
  else
  {
    strncpy(samp, sampByte, 5);
  }
  
  textLength = strlen(testText);
  write("testText length %d bytes", strlen(testText));
  
  /*  MAIN FUNCTION */
  ent = ENT_ent(testText, strlen(testText), 0);
  chisq = ENT_chisq(testText, strlen(testText), 0);
  mean= ENT_mean(testText, strlen(testText), 0);
  montepi= ENT_montepi(testText, strlen(testText), 0);
  scc= ENT_scc(testText, strlen(testText), 0);
  chip= ENT_chip(testText, strlen(testText), 0);
  compRate = ENT_compRate(testText, strlen(testText), 0);
  errorPct = ENT_errorPct(testText, strlen(testText), 0);
  
  
  write("Entropy = %f bits per %s.", ent, samp);
  write("\nOptimum compression would reduce the size");
  write("of this %ld %s file by %d percent.\n", textLength, samp, compRate);
  write("Chi square distribution for %ld samples is %1.2f, and randomly", textLength, chisq);
  if (chip < 0.0001){
    write("would exceed this value less than 0.01 percent of the times.\n");
  } else if (chip > 0.9999){
    write("would exceed this value more than than 99.99 percent of the times.\n");
  } else {
    write("would exceed this value %1.2f percent of the times.\n", chip * 100);
  }
  write("Arithmetic mean value of data %ss is %1.4f (%.1f = random).", samp, mean, binary ? 0.5 : 127.5);
  write("Monte Carlo value for Pi is %1.9f (error %1.2f percent).", montepi, errorPct);
  if (scc >= -99999){
    write("Serial correlation coefficient is %1.6f (totally uncorrelated = 0.0).", scc);
  } else {
    write("Serial correlation coefficient is undefined (all values equal!).");
  }
  
}

on preStart
{
  /* This function will register the CAPLDLL.
     The handle is important for all function calls.  
     It will indent the CAPL node in the DLL */   

  writeLineEx(1,1,"");
  writeLineEx(1,1,"");
  writeLineEx(1,1,"--------------------- CAPL-DLL Example -----------------------");
  writeLineEx(1,1,"");
  writeLineEx(1,1,"Start procedure:");
  gHandle = registerCAPLDLL();
  writeLineEx(1,1,"1. DLL Registration:   Handle = %d", gHandle);
  
  writeLineEx(1,1,"2. DLL Initialization: Done!"); 
  dllInit(gHandle);

  Help();
}

//on start 
//{
//  writeLineEx(1,1,"2. DLL Initialization: Done!");  
//  
//  /* This function will initialize all callback 
//     functions in the CAPLDLL. The handle include 
//     the register ID number of CAPL node. */
//  dllInit(gHandle);
//
//}

//on key '1'
//{
//  writeLineEx(1,1,"");
//  writeLineEx(1,1,"");
//  writeLineEx(1,1,"");
//  writeLineEx(1,1,"<1> Direct call of a CAPL Callback Function");
//  writeLineEx(1,1,"--------------------------------------------------------------");
//  writeLineEx(1,1,"Call: CAPL CallBack Function CALLBACK_ShowValue(21)");
//  CALLBACK_ShowValue(21); /* Direct call of one callback function */
//  writeLineEx(1,1,"--------------------------------------------------------------");
//}
//
//on key '2'
//{
//  long value;
//
//  writeLineEx(1,1,"");
//  writeLineEx(1,1,"");
//  writeLineEx(1,1,"");
//  writeLineEx(1,1,"<2> Call of CAPL Callback Functions by the DLL");
//  writeLineEx(1,1,"--------------------------------------------------------------");
//  /* The DLL is informed to call some callback functions. The informations will written in the write windows */
//
//  writeLineEx(1,1,"Call CAPL DLL Function dllSetValue(handle,0x01)");
//  value = dllSetValue(gHandle,0x01);
//
//  /* The DLL is informed to call some callback functions. The informations will written in the write windows */
//  writeLineEx(1,1,"");
//  writeLineEx(1,1,"Call CAPL DLL Function dllReadData(handle, 0x12345678)");
//  value = dllReadData(gHandle, 0x12345678);
//  writeLineEx(1,1,"--------------------------------------------------------------");
//}
//
//on key '3'
//{
//
//  /* This functions put two datas from CAPL to DLL*/ 
//  writeLineEx(1,1,"");
//  writeLineEx(1,1,"");
//  writeLineEx(1,1,"");
//  writeLineEx(1,1,"<3> Save data from CAPL to DLL memory");
//  writeLineEx(1,1,"    Read data from DLL memory to CAPL");
//  writeLineEx(1,1,"--------------------------------------------------------------");
//  writeLineEx(1,1,"Call CAPL DLL Function dllPut(36)");
//  dllPut(36);
//  writeLineEx(1,1,"Call CAPL DLL Function dllGet()  Result = %d ", (int)dllGet());
//
//  writeLineEx(1,1,"");
//
//  writeLineEx(1,1,"Call CAPL DLL Function dllPut(0x24)");
//  dllPut(0x24);
//  writeLineEx(1,1,"Call CAPL DLL Function dllGet()  Result = 0x%x ", (int)dllGet());
//  writeLineEx(1,1,"--------------------------------------------------------------");
//}
//
//on key '4'
//{
//  writeLineEx(1,1,"");
//  writeLineEx(1,1,"");
//  writeLineEx(1,1,"");
//  writeLineEx(1,1,"<4> Overwrite DLL memory from CAPL without parameter");
//  writeLineEx(1,1,"    Read value from CAPL DLL memory in CAPL back");
//  writeLineEx(1,1,"--------------------------------------------------------------");
//  writeLineEx(1,1,"Call CAPL DLL Function dllvoid()");
//  dllvoid(); 
//  
//  writeLineEx(1,1,"Call CAPL DLL Function dllGet()  Result = 0x%x ", (int)dllGet());
//  writeLineEx(1,1,"--------------------------------------------------------------");
//}
//
//on key '5'
//{
//  int i;
//  byte buffer[10];
//
//  writeLineEx(1,1,"");
//  writeLineEx(1,1,"");
//  writeLineEx(1,1,"");
//  writeLineEx(1,1,"<5> Save one data buffer from CAPL array to DLL memory");
//  writeLineEx(1,1,"    Read DLL memory from CAPL");
//  writeLineEx(1,1,"--------------------------------------------------------------");
//  writeLineEx(1,1,"Call CAPL DLL Function dllPutDataOnePar(gBufferPut)");
//  dllPutDataOnePar(gBufferPut);  /* This function put data from CAPL array to DLL*/ 
//
//  writeLineEx(1,1,"Call CAPL DLL Function dllGetDataOnePar(buffer)");
//  dllGetDataOnePar(buffer);  /* This function get data from DLL into CAPL memory*/  
//
//  for(i = 0; i < 10; ++i) 
//  {
//    writeLineEx(1,1,"gBufferPut: gBufferPut[%d] = %d", i, gBufferPut[i]);
//  }
//  writeLineEx(1,1,"--------------------------------------------------------------");
//}
//
//on key '6'
//{
//  int i;
//  int number = 6;
//  byte buffer[10];
//
//  writeLineEx(1,1,"");
//  writeLineEx(1,1,"");
//  writeLineEx(1,1,"");
//  writeLineEx(1,1,"<6> Save two data from CAPL array to DLL memory");
//  writeLineEx(1,1,"    Read DLL memory from CAPL");
//  writeLineEx(1,1,"--------------------------------------------------------------");
//  writeLineEx(1,1,"Call CAPL DLL Function dllPutDataTwoPars(number,gBufferPut)");
//  dllPutDataTwoPars(number, gBufferPut);  /* This function put two datas from CAPL array to DLL*/ 
//
//
//  writeLineEx(1,1,"Call CAPL DLL Function dllGetDataOnePar(number,buffer)");
//  dllGetDataTwoPars(number, buffer);  /* This function get two datas from DLL into CAPL memory*/
//
//  for(i = 0; i < 10; ++i) 
//  {
//    writeLineEx(1,1,"Result buffer[%d] = %d", i, buffer[i]);
//  }
//  writeLineEx(1,1,"--------------------------------------------------------------");
//}
//
//on key '7'
//{
//  long par1 = 7;
//  long par2 = 6;
//  long result;
//
//  writeLineEx(1,1,"");
//  writeLineEx(1,1,"");
//  writeLineEx(1,1,"");
//  writeLineEx(1,1,"<7> Calculate the value by the DLL");
//  writeLineEx(1,1,"    The return value is the result!");
//  writeLineEx(1,1,"--------------------------------------------------------------");
//  result = dllAdd(par1, par2);  /* This function will add two values. The return value is the result	*/ 
//  writeLineEx(1,1,"Call CAPL DLL Function dllAdd(7 + 6)  Result = %d",result);
//
//  result = dllSubtract(par1, par2);  /* This function will substract two values. The return value is the result	*/ 
//  writeLineEx(1,1,"Call CAPL DLL Function dllAdd(7 - 6)  Result = %d",result);
//  writeLineEx(1,1,"--------------------------------------------------------------");
//}
//
//on key '8'
//{
//  long result;
//  
//  writeLineEx(1,1,"");
//  writeLineEx(1,1,"");
//  writeLineEx(1,1,"");
//  writeLineEx(1,1,"<8> Support of long function names calls");
//
//  writeLineEx(1,1,"--------------------------------------------------------------");  
//  result = dllSupportLongFunctionNamesWithUpTo50Characters(); 
//  writeLineEx(1,1,"Call CAPL DLL Function dllSupportLongFunctionNamesWithUpTo50Characters()  Result = %d",result);
//  writeLineEx(1,1,"--------------------------------------------------------------");
//}
//
//on key '9'
//{
//  long par01 =  1; long par02 =  2; long par03 =  3; long par04 =  4; long par05 =  5; long par06 =  6; long par07 =  7; long par08 =  8;
//  long par09 =  9; long par10 = 10; long par11 = 11; long par12 = 12; long par13 = 13; long par14 = 14; long par15 = 15; long par16 = 16;
//  long par17 = 17; long par18 = 18; long par19 = 19; long par20 = 20; long par21 = 21; long par22 = 22; long par23 = 23; long par24 = 24;
//  long par25 = 25; long par26 = 26; long par27 = 27; long par28 = 28; long par29 = 29; long par30 = 30; long par31 = 31; long par32 = 32;
//  long par33 = 33; long par34 = 34; long par35 = 35; long par36 = 36; long par37 = 37; long par38 = 38; long par39 = 39; long par40 = 40;
//  long par41 = 41; long par42 = 42; long par43 = 43; long par44 = 44; long par45 = 45; long par46 = 46; long par47 = 47; long par48 = 48;
//  long par49 = 49; long par50 = 50; long par51 = 51; long par52 = 52; long par53 = 53; long par54 = 54; long par55 = 55; long par56 = 56;
//  long par57 = 57; long par58 = 58; long par59 = 59; long par60 = 60; long par61 = 61; long par62 = 62; long par63 = 63; long par64 = 64;
//  long result;
//
//  writeLineEx(1,1,"");
//  writeLineEx(1,1,"");
//  writeLineEx(1,1,"");
//  writeLineEx(1,1,"<9> Calculate the sum of many parameters by the DLL");
//  writeLineEx(1,1,"    The return value is the result!");
//  writeLineEx(1,1,"--------------------------------------------------------------");
//  result = dllAdd63Parameters(par01, par02, par03, par04, par05, par06, par07, par08,
//                              par09, par10, par11, par12, par13, par14, par15, par16,
//                              par17, par18, par19, par20, par21, par22, par23, par24,
//                              par25, par26, par27, par28, par29, par30, par31, par32,
//                              par33, par34, par35, par36, par37, par38, par39, par40,
//                              par41, par42, par43, par44, par45, par46, par47, par48,
//                              par49, par50, par51, par52, par53, par54, par55, par56,
//                              par57, par58, par59, par60, par61, par62, par63);  /* This function will add 63 values. The return value is the result	*/ 
//  writeLineEx(1,1,"Call CAPL DLL Function dllAdd63Parameters(<Values 1..63>)  Result = %d",result);
//
//  result = dllAdd64Parameters(par01, par02, par03, par04, par05, par06, par07, par08,
//                              par09, par10, par11, par12, par13, par14, par15, par16,
//                              par17, par18, par19, par20, par21, par22, par23, par24,
//                              par25, par26, par27, par28, par29, par30, par31, par32,
//                              par33, par34, par35, par36, par37, par38, par39, par40,
//                              par41, par42, par43, par44, par45, par46, par47, par48,
//                              par49, par50, par51, par52, par53, par54, par55, par56,
//                              par57, par58, par59, par60, par61, par62, par63, par64);  /* This function will add 64 values. The return value is the result	*/ 
//  writeLineEx(1,1,"Call CAPL DLL Function dllAdd64Parameters(<Values 1..64>)  Result = %d",result);
//  writeLineEx(1,1,"--------------------------------------------------------------");
//}
//
//on key 'h'
//{
//  writeLineEx(1,1,"");
//  Help();
//}
//
//on stopMeasurement
//{
//  /* This function will release the CAPL function 
//     handle in the CAPLDLL */
//  dllEnd(gHandle);
//}
//
//void CALLBACK_ArrayValues(dword flags, byte databytes[], byte controlcode)
//{
//  char datadump[100];
//  char byteAsText[10];
//  int i;
//
//  /* Callback function */
//  /* This function will demonstrated an Callback with array parameters. */
//
//  strncpy (datadump, "[", 100);
//
//  for (i=0; i<elcount(databytes); i++)
//  {
//    if (i>0)
//    {
//      strncat(datadump, " ", 100);
//    }
//    snprintf(byteAsText, 10, "%02x", databytes[i]);
//    strncat(datadump, byteAsText, 100);
//  }
//  strncat (datadump, "]", 100);
//  writeLineEx(1,1,"CAPL CallBack Function shows ArrayValues(%x,%s,%x)",flags, datadump, controlcode);
//}
//
//void CALLBACK_DllInfo(char text[])
//{
//  /* Callback function */
//  /* This function will demonstrated an Callback with character parameters */
//  writeLineEx(1,1,"CAPL CallBack Function shows Dll Info = %s", text);
//}
//
//void CALLBACK_DllVersion(char text[])
//{
//  /* Callback function */
//  /* This function will demonstrated an Callback with character parameters */
//  writeLineEx(1,1,"CAPL CallBack Function shows Dll Version = %s", text);
//}
//
//dword CALLBACK_ShowDates(int x, dword y, int z)
//{
//  /* Callback function */
//  /* This function will demonstrated an Callback with more than one parameters. */
//  writeLineEx(1,1,"CAPL CallBack Function shows data (%d,%lx,%d) return with 1", x, y, z);
//  return 1;
//}
//
//dword CALLBACK_ShowValue(dword x)
//{
//  /* Callback function */
//  /* This function will demonstrated an Callback with one parameters. */
//  writeLineEx(1,1,"CAPL CallBack Function shows value = 0x%x",x);
//  return 2;
//}

Help ()
{
  writeLineEx(1,1,""); 
  writeLineEx(1,1,"--------------------------------------------------------------");
  writeLineEx(1,1,""); 
  writeLineEx(1,1,"Use the keyboard to control the program");
  writeLineEx(1,1,"<1> Direct call of a CAPL Callback function");
  writeLineEx(1,1,"<2> Call of CAPL Callback Functions by the DLL");
  writeLineEx(1,1,"<3> Save data from CAPL to DLL memory");
  writeLineEx(1,1,"<4> Overwrite DLL memory from CAPL without parameter");
  writeLineEx(1,1,"<5> Save one data buffer from CAPL array to DLL");
  writeLineEx(1,1,"<6> Save two data buffer from CAPL array to DLL");
  writeLineEx(1,1,"<7> Calculate the value by the DLL");
  writeLineEx(1,1,"<8> Support of long function names");
  writeLineEx(1,1,"<9> Calculate the sum of many parameters by the DLL");
  writeLineEx(1,1,"<h> Help");
  writeLineEx(1,1,""); 
  writeLineEx(1,1,"--------------------------------------------------------------");
}
